## conf/bblayers.conf.sample
```bitbake
# LAYER_CONF_VERSION is increased each time build/conf/bblayers.conf
# changes incompatibly
LCONF_VERSION = "6"

BBPATH = "${TOPDIR}"
BBFILES ?= ""

BBLAYERS ?= " \
  ##COREBASE##/meta \
  ##COREBASE##/../meta-xilinx/meta-xilinx-bsp \
  ##COREBASE##/../meta-xilinx/meta-xilinx-standalone \
  ##COREBASE##/../meta-xilinx/meta-xilinx-contrib \
  ##COREBASE##/../meta-qt5 \
  ##COREBASE##/../meta-walkthetalk \
"
```

## conf/distro/optimus.conf
```bitbake
DISTRO = "optimus"
DISTRO_NAME = "PANGU (Built by optimus)"
DISTRO_VERSION = "4.1+snapshot-${DATE}"
DISTRO_CODENAME = "langdale"
SDK_VENDOR = "-optimussdk"
SDK_VERSION = "${@d.getVar('DISTRO_VERSION').replace('snapshot-${METADATA_REVISION}', 'snapshot')}"
SDK_VERSION[vardepvalue] = "${SDK_VERSION}"

MAINTAINER = "niqingliang <niqingliang2003@gmail.com>"

TARGET_VENDOR = "-walkthetalk"

LOCALCONF_VERSION = "2"

# remove 'x11 nfs zeroconf pci 3g nfc opengl xattr' in DISTRO_FEATURES_DEFAULT
DISTRO_FEATURES_DEFAULT = "alsa argp bluetooth ext2 irda largefile pcmcia usbgadget usbhost wifi"
OPTIMUS_DEFAULT_DISTRO_FEATURES = "largefile multiarch"
OPTIMUS_DEFAULT_EXTRA_RDEPENDS = "packagegroup-core-boot"
OPTIMUS_DEFAULT_EXTRA_RRECOMMENDS = "kernel-module-af-packet"

DISTRO_FEATURES ?= "${DISTRO_FEATURES_DEFAULT} ${OPTIMUS_DEFAULT_DISTRO_FEATURES}"
DISTRO_EXTRA_RDEPENDS += " ${OPTIMUS_DEFAULT_EXTRA_RDEPENDS}"
DISTRO_EXTRA_RRECOMMENDS += " ${OPTIMUS_DEFAULT_EXTRA_RRECOMMENDS}"

SDK_NAME = "${DISTRO}-${TCLIBC}-${SDKMACHINE}-${IMAGE_BASENAME}-${TUNE_PKGARCH}-${MACHINE}"
SDKPATHINSTALL = "/opt/${DISTRO}/${SDK_VERSION}"

TCLIBCAPPEND = ""

PACKAGE_CLASSES ?= "package_rpm"

PREMIRRORS ??= "\
bzr://.*/.*   https://downloads.yoctoproject.org/mirror/sources/ \n \
cvs://.*/.*   https://downloads.yoctoproject.org/mirror/sources/ \n \
git://.*/.*   https://downloads.yoctoproject.org/mirror/sources/ \n \
gitsm://.*/.* https://downloads.yoctoproject.org/mirror/sources/ \n \
hg://.*/.*    https://downloads.yoctoproject.org/mirror/sources/ \n \
osc://.*/.*   https://downloads.yoctoproject.org/mirror/sources/ \n \
p4://.*/.*    https://downloads.yoctoproject.org/mirror/sources/ \n \
svn://.*/.*   https://downloads.yoctoproject.org/mirror/sources/ \n"

# add poky sanity bbclass
#INHERIT += "poky-sanity"

# QA check settings - a little stricter than the OE-Core defaults
# (none currently necessary as we now match OE-Core)
#WARN_TO_ERROR_QA = "X"
#WARN_QA_remove = "${WARN_TO_ERROR_QA}"
#ERROR_QA_append = " ${WARN_TO_ERROR_QA}"

require conf/distro/include/no-static-libs.inc

BB_SIGNATURE_HANDLER ?= "OEEquivHash"
BB_HASHSERVE ??= "auto"

# for systemd
INIT_MANAGER ?= "systemd"
```

## conf/layer.conf
```bitbake
# We have a conf and classes directory, add to BBPATH
BBPATH =. "${LAYERDIR}:"

# We have recipes-* directories, add to BBFILES
BBFILES += "${LAYERDIR}/recipes-*/*/*.bb \
            ${LAYERDIR}/recipes-*/*/*.bbappend"

BBFILE_COLLECTIONS += "walkthetalk"
BBFILE_PATTERN_walkthetalk := "^${LAYERDIR}/"
BBFILE_PRIORITY_walkthetalk = "6"

# This should only be incremented on significant changes that will
# cause compatibility issues with other layers
LAYERVERSION_walkthetalk = "3"
LAYERSERIES_COMPAT_walkthetalk = "warrior zeus"

LAYERDEPENDS_walkthetalk = "core qt5-layer"
```

## conf/machine/fsref.conf
```bitbake
#@TYPE: Machine
#@NAME: fsref-zynq7
#@DESCRIPTION: copy frm picozed-zynq7.conf

################################################################################
# require conf/machine/include/tune-zynq.inc
DEFAULTTUNE ?= "cortexa9thf-neon"
SOC_FAMILY ?= "zynq"

# Available SOC_VARIANT's for zynq:
# 7zs - Zynq-7000 Single A9 Core
# 7z  - Zynq-7000 Dual A9 Core
SOC_VARIANT ?= "7z"

require conf/machine/include/arm/armv7a/tune-cortexa9.inc
require conf/machine/include/soc-family.inc


################################################################################
#require conf/machine/include/machine-xilinx-overrides.inc
MACHINEOVERRIDES =. "${@['', '${SOC_FAMILY}${SOC_VARIANT}:']['${SOC_VARIANT}' != '']}"

PACKAGE_EXTRA_ARCHS:append = " ${SOC_FAMILY}"
PACKAGE_EXTRA_ARCHS:append = "${@['', ' ${SOC_FAMILY}${SOC_VARIANT}']['${SOC_VARIANT}' != '']}"


################################################################################
#require conf/machine/include/machine-xilinx-default.inc
# Default Xilinx BSP Machine settings

MACHINE_FEATURES_BACKFILL_CONSIDERED += "rtc"

# File System Configuration
IMAGE_FSTYPES ?= "tar.gz cpio cpio.gz.u-boot"

XSERVER ?= " \
	xserver-xorg \
	xf86-input-evdev \
	xf86-input-mouse \
	xf86-input-keyboard \
	xf86-video-fbdev \
	"
FPGA_MNGR_RECONFIG_ENABLE ?= "${@bb.utils.contains('IMAGE_FEATURES', 'fpga-manager', '1', '0', d)}"

################################################################################
MACHINE_FEATURES = ""

# u-boot configuration
PREFERRED_PROVIDER_virtual/bootloader = "u-boot"
UBOOT_MACHINE = "zynq_fsref_defconfig"
SPL_BINARY ?= "spl/boot.bin"
UBOOT_ELF = "u-boot"
UBOOT_SUFFIX ?= "img"
UBOOT_BINARY ?= "u-boot.${UBOOT_SUFFIX}"

# kernel configuration
# NOTE: the uboot_entrypoint is used for kernel in fitimage
UBOOT_ENTRYPOINT = "0x8800000"
KERNEL_CLASSES += "zynq_fitimage"
PREFERRED_PROVIDER_virtual/kernel = "linux-official"
KERNEL_IMAGETYPE = "uImage"
KERNEL_IMAGETYPES += "zImage fitImage"
# NOTE: when loaded by u-boot SPL, it should skip spl bss/pool,
#       please see zynq-common.h in uboot
#         CONFIG_SYS_SPL_MALLOC_START	// in config is 2MB
#         CONFIG_SYS_SPL_MALLOC_SIZE	// in zynq-common.h is 32MB
#         CONFIG_SPL_BSS_START_ADDR	// 1MB
#         CONFIG_SPL_BSS_MAX_SIZE	// 1MB
# NOTE: lower 1 MB of DDR may be not valid at SPL stage.
# NOTE: the u-boot will located at 64MB (CONFIG_SYS_TEXT_BASE in config)
# NOTE: https://forums.xilinx.com/t5/Embedded-Linux/How-to-boot-linux-by-bypassing-uboot/td-p/526823
#      1. Alter the Linux kernel configuration to use an appended DTB.
#      2. Build the kernel (zImage) and the device tree.
#      3. this assumes using a initramfs ramdisk as Petalinux does to get a single monolithic binary image
#      4. Concatenate the kernel and dtb files into one file (cat zImage system.dtb > zImage.withdtb.bin)
#      5. Create a BIF file to only load FSBL and zImage.withdtb.bin.
#      6. image : {
#      7.         [bootloader]zynq_fsbl.elf
#      8.         [load=0x8800000,startup=0x8800000]zImage.withdtb.bin
#      9. }
#     10. Build a new boot.bin
# Note: Linux must be loaded at or above 0x8800000 to prevent the Linux kernel
#       wrapper from decompressing the kernel into the lower 1 MB of DDR which
#       is not mapped into low memory at this point as it’s typically done in
#       u-boot. It appears that Linux does map the lower 1 MB DDR into low
#       memory as devmem works for address 0 but this probably needs some verifying.
KERNEL_EXTRA_ARGS += "UIMAGE_LOADADDR=0x8800000"
KERNEL_MACHINE = "fsref_defconfig"
KERNEL_DEVICETREE = "zynq-fsref-sdcard.dtb zynq-fsref-emmc.dtb"

FPGA_FILENAME = "system.bit.bin.tm050"
FPGA_LOADADDR = "0x9000000"

# NOTE: drop virtual/boot-bin, because u-boot doesn't provide it.
EXTRA_IMAGEDEPENDS += " \
		virtual/bootloader \
		"

SERIAL_CONSOLE = "115200 ttyPS0"

IMAGE_BOOT_FILES = " \
		boot.bin \
		${UBOOT_BINARY} \
		${KERNEL_IMAGETYPE} \
		${KERNEL_IMAGETYPES} \
		${@os.path.basename(KERNEL_DEVICETREE)} \
		"

# NOTE: with both jpeg/png disabled will result in compiling fail
PACKAGECONFIG:pn-opencv := "png"

PACKAGECONFIG:pn-libwebsockets := "externalpoll server http2"

# NOTE: if no 'openssl', need '--disable-strong-random' for configure
PACKAGECONFIG:pn-postgresql := "openssl uuid"


PACKAGECONFIG:append:pn-qtbase = " \
	linuxfb \
	libinput xkbcommon \
	accessibility sql-sqlite sql-psql no-opengl \
"
PACKAGECONFIG:append:pn-qtvirtualkeyboard = " arrow-keynavigation"
```

## conf/machine/include/tune-zen1.inc
```bitbake
require conf/machine/include/tune-amd64.inc

TUNEVALID[zen1] = "Enable AMD x86 (64 bit) Zen 1 Core Architecture specific optimizations"
TUNE_FEATURES:tune-amd64 = "m64 zen1"
TUNE_CCARGS .= "${@bb.utils.contains('TUNE_FEATURES', 'zen1', ' -march=znver1', '', d)}"
```

## conf/machine/include/tune-zen2.inc
```bitbake
require conf/machine/include/tune-amd64.inc

TUNEVALID[zen2] = "Enable AMD x86 (64 bit) Zen 2 Core Architecture specific optimizations"
TUNE_FEATURES:tune-amd64 = "m64 zen2"
TUNE_CCARGS .= "${@bb.utils.contains('TUNE_FEATURES', 'zen2', ' -march=znver2', '', d)}"
```

## conf/machine/include/tune-zen3.inc
```bitbake
require conf/machine/include/tune-amd64.inc

TUNEVALID[zen3] = "Enable AMD x86 (64 bit) Zen 3 Core Architecture specific optimizations"
TUNE_FEATURES:tune-amd64 = "m64 zen3"
TUNE_CCARGS .= "${@bb.utils.contains('TUNE_FEATURES', 'zen3', ' -march=znver3', '', d)}"
```

## conf/machine/medx86-64.conf
```bitbake
#@TYPE: Machine
#@NAME: Generic x86_64
#@DESCRIPTION: Machine configuration for generic x86_64 (64-bit) PCs and servers. Supports a moderately wide range of drivers that should boot and be usable on "typical" hardware.

DISTRO_FEATURES+=" vulkan"

DEFAULTTUNE ?= "core2-64"
require conf/machine/include/x86/tune-core2.inc
include conf/machine/include/x86/x86-base.inc
require conf/machine/include/x86/qemuboot-x86.inc
MACHINE_FEATURES += "wifi efi pcbios"

PREFERRED_PROVIDER_virtual/kernel ?= "linux-official"
KERNEL_MACHINE ?= "x86_64_defconfig"
MACHINE_EXTRA_RRECOMMENDS += "kernel-modules linux-firmware"

GLIBC_ADDONS = "nptl"

IMAGE_FSTYPES += "wic wic.bmap"
WKS_FILE ?= "genericx86.wks.in"
EFI_PROVIDER ??= "grub-efi"
do_image_wic[depends] += "gptfdisk-native:do_populate_sysroot"
do_image_wic[recrdeptask] += "do_bootimg"

SERIAL_CONSOLES_CHECK = "ttyS0"
#For runqemu
QB_SYSTEM_NAME = "qemu-system-x86_64"
```
